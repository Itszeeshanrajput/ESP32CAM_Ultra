#pragma once
#include "camera_tasks.h"
#include "web_ui.h"      // generated by tools/build_ui.py from ui/index.html (gzip -> C array)

WebServer server(80);
static const char* HDRS[] = {"Cookie", "X-CSRF"};
uint8_t* capBuf = nullptr;

static void sendJson(int code, const String& j) { server.sendHeader("Cache-Control", "no-store"); if (ESP.getFreeHeap() < MEM_CRIT) { server.send(503, "application/json", "{\"error\":\"out-of-memory\"}"); return; } server.send(code, "application/json", j); }
static void sendOk() { sendJson(200, "{\"ok\":true}"); }
static void sendErr(int code, const char* m) { sendJson(code, String("{\"error\":\"") + m + "\"}"); }
static uint8_t curRole() { return roleFromCookie(server.header("Cookie").c_str()); }
static Session* curSession() { char sid[40]; if (!cookieGet(server.header("Cookie").c_str(), "sid", sid, sizeof sid)) return nullptr; return findSession(sid); }
static bool csrfOk() { if (!S_authon) return true; Session* s = curSession(); String h = server.header("X-CSRF"); return s && ctEq(s->csrf, h.c_str()); }

// Every API route passes through here: role check, forced password change, CSRF for state-changing calls.
static bool guard(uint8_t minRole, bool csrf, bool allowMust = false) {
  uint8_t r = curRole();
  if (r < minRole) { sendErr(r ? 403 : 401, "auth"); return false; }
  if (S_authon) {
    if (pwMustChange && !allowMust) { sendErr(403, "pwchange"); return false; }
    if (csrf && !csrfOk()) { sendErr(403, "csrf"); return false; }
  }
  return true;
}
#define GETR(path, role, fn)  server.on(path, HTTP_GET,  []() { if (!guard(role, false)) return; fn(); })
#define POSTR(path, role, fn) server.on(path, HTTP_POST, []() { if (!guard(role, true))  return; fn(); })
static uint32_t clientIp() { return (uint32_t)server.client().remoteIP(); }

// ------------------------------ session / accounts ---------------------------
static void hSession() {
  uint8_t r = curRole(); Session* s = curSession(); String j = "{";
  j += String("\"auth\":") + (S_authon ? "true" : "false") + ",\"role\":" + r + ",\"csrf\":\"" + ((s && r) ? s->csrf : "") + "\",\"must\":" + ((S_authon && pwMustChange && r) ? "true" : "false");
  j += String(",\"fw\":\"") + FW_VERSION + "\",\"name\":\"" + jsonEsc(S_camname) + "\",\"user\":\"" + jsonEsc(acctAdmin.user) + "\",\"viewer\":\"" + jsonEsc(acctViewer.user) + "\"}";
  sendJson(200, j);
}
static void hLogin() {
  uint32_t ip = clientIp();
  if (lockedOut(ip)) { sendErr(429, "locked"); return; }
  if (!S_authon) { hSession(); return; }
  uint8_t role = verifyLogin(server.arg("user").c_str(), server.arg("pass").c_str());
  if (!role) { noteFail(ip); delay(400); logmsg(LVL_WARN, "AUTH", "Failed login from %s", server.client().remoteIP().toString().c_str()); sendErr(401, "bad"); return; }
  noteOk(ip); Session* s = createSession(role);
  server.sendHeader("Set-Cookie", String("sid=") + s->sid + "; Path=/; HttpOnly; SameSite=Strict; Max-Age=43200");
  logmsg(LVL_INFO, "AUTH", "%s login from %s", role == ROLE_ADMIN ? "Admin" : "Viewer", server.client().remoteIP().toString().c_str());
  sendJson(200, String("{\"ok\":true,\"role\":") + role + ",\"csrf\":\"" + s->csrf + "\",\"must\":" + ((pwMustChange && role == ROLE_ADMIN) ? "true" : "false") + "}");
}
static void hLogout() {
  Session* s = curSession(); if (s) s->used = false;
  server.sendHeader("Set-Cookie", "sid=; Path=/; HttpOnly; SameSite=Strict; Max-Age=0"); sendOk();
}
static void hAccount() {
  String role = server.arg("role"), user = server.arg("user"), pass = server.arg("pass");
  if (role == "viewer") {
    if (server.arg("remove") == "1") { memset(&acctViewer, 0, sizeof acctViewer); saveAccounts(); sendOk(); return; }
    if (user.length() < 2 || user.length() > 23 || pass.length() < 6 || user == acctAdmin.user) { sendErr(400, "invalid"); return; }
    setAccount(acctViewer, user.c_str(), pass.c_str()); saveAccounts(); logmsg(LVL_INFO, "AUTH", "Viewer account updated"); sendOk(); return;
  }
  if (verifyLogin(acctAdmin.user, server.arg("cur").c_str()) != ROLE_ADMIN) { sendErr(403, "wrongcur"); return; }
  if (user.length() < 2 || user.length() > 23 || pass.length() < 6 || pass == "admin" || user == acctViewer.user) { sendErr(400, "weak"); return; }
  setAccount(acctAdmin, user.c_str(), pass.c_str()); pwMustChange = false; saveAccounts();
  Session* me = curSession(); for (auto& s : sessions) if (&s != me) s.used = false;        // other logins are revoked
  logmsg(LVL_INFO, "AUTH", "Admin credentials changed"); sendOk();
}

// ------------------------------ configuration ---------------------------------
static void hConfigGet() {
  if (curRole() < ROLE_ADMIN) { sendJson(200, String("{\"v\":{\"camname\":\"") + jsonEsc(S_camname) + "\"}}"); return; }
  String j = "{\"v\":"; settingsJson(j, false);
  j += String(",\"set\":{\"tgtoken\":") + (S_tgtoken[0] ? "true" : "false") + ",\"mqpass\":" + (S_mqpass[0] ? "true" : "false") + "}";
  j += ",\"sizes\":["; for (int i = 0; i < SIZES_N; i++) { if (i) j += ","; j += String("{\"v\":") + SIZES[i].fs + ",\"l\":\"" + SIZES[i].label + "\"}"; }
  j += String("],\"fw\":\"") + FW_VERSION + "\",\"apSsid\":\"" + apSsid + "\",\"canRec\":" + (recSupported ? "true" : "false") +
       ",\"mqtt\":" +
#ifdef HAVE_MQTT
       "true"
#else
       "false"
#endif
       + "}";
  sendJson(200, j);
}
static int applyArgs(bool skipAuth = false) {          // shared by POST /api/config and presets
  void (*cbs[8])() = {0}; int nc = 0, changed = 0;
  for (int i = 0; i < server.args(); i++) {
    const Setting* s = findSetting(server.argName(i).c_str()); if (!s) continue;
    if (settingApply(*s, server.arg(i))) { changed++; settingSave(*s); if (s->cb) { bool dup = false; for (int k = 0; k < nc; k++) if (cbs[k] == s->cb) dup = true; if (!dup && nc < 8) cbs[nc++] = s->cb; } }
  }
  for (int k = 0; k < nc; k++) cbs[k](); return changed;
}
static void hConfigPost() { int n = applyArgs(); if (n) logmsg(LVL_INFO, "CFG", "%d setting(s) changed", n); sendJson(200, String("{\"ok\":true,\"changed\":") + n + "}"); }
static void setKV(const char* k, const char* v) { const Setting* s = findSetting(k); if (s && settingApply(*s, v)) { settingSave(*s); } }
static void hPreset() {                                 // one-tap camera profiles
  String n = server.arg("name");
  if (n == "day")         { setKV("quality", "10"); setKV("contrast", "1"); setKV("sat", "1"); setKV("bright", "0"); setKV("aec", "1"); setKV("agc", "1"); setKV("lowlight", "0"); setKV("aelevel", "0"); }
  else if (n == "night")  { setKV("quality", "14"); setKV("contrast", "0"); setKV("sat", "0"); setKV("bright", "1"); setKV("aec", "1"); setKV("agc", "1"); setKV("lowlight", "1"); setKV("aelevel", "1"); }
  else if (n == "indoor") { setKV("quality", "12"); setKV("contrast", "1"); setKV("sat", "0"); setKV("bright", "0"); setKV("wb", "3"); setKV("lowlight", "1"); setKV("aelevel", "0"); }
  else { sendErr(400, "preset"); return; }
  cbCam(); cbNight(); logmsg(LVL_INFO, "CFG", "Preset %s applied", n.c_str()); sendOk();
}
static void hBackup() {
  String j; settingsJson(j, true); server.sendHeader("Content-Disposition", "attachment; filename=\"esp32cam-config.json\""); sendJson(200, j);
}

// ---------------------------------- status ------------------------------------
#define TF(x) ((x) ? "true" : "false")
static void hStatus() {                                   // hot path (polled): no SD access, no locks, no heap churn
  char ts[24]; tsHumanBuf(ts, sizeof ts); bool up = WiFi.status() == WL_CONNECTED;
  static const char* sds[] = {"ok", "degraded", "remounting", "missing"};
  String ssid = jsonEsc(curSsid), wm = jsonEsc(joinMsg), rf = jsonEsc(recFileNow), rr = jsonEsc(lastResetReasonStr.c_str());
  char ip[20] = ""; if (up) strlcpy(ip, WiFi.localIP().toString().c_str(), sizeof ip);
  char b[1200];
  snprintf(b, sizeof b, "{\"up\":%lu,\"time\":\"%s\",\"timeOk\":%s,\"timeApprox\":%s,\"heap\":%u,\"minHeap\":%u,\"psram\":%u,\"fps\":%.1f,\"viewers\":%d,\"rec\":%s,\"recFile\":\"%s\","
    "\"armed\":%s,\"night\":%s,\"motion\":%s,\"mscore\":%u,\"sd\":%s,\"sdState\":\"%s\",\"sdTotalMB\":%lu,\"sdFreeMB\":%lu,\"cam\":%s,\"canRec\":%s,\"drop\":%lu,\"frames\":%lu,\"events\":%lu,"
    "\"rssi\":%d,\"ip\":\"%s\",\"ssid\":\"%s\",\"ap\":%s,\"apSsid\":\"%s\",\"wmsg\":\"%s\",\"flash\":%d,\"temp\":%.1f,\"rr\":\"%s\"}",
    (unsigned long)(millis() / 1000), ts, TF(timeOK()), TF(timeApprox), (unsigned)ESP.getFreeHeap(), (unsigned)minFreeHeapSeen, (unsigned)ESP.getFreePsram(), (double)currentFPS, (int)viewerCount,
    TF(contWriter.isOpen() || motionWriter.isOpen()), rf.c_str(), TF(S_armed), TF(nightState), TF(motionOn), (unsigned)motionScoreLive, TF(sdCardMounted), sds[constrain((int)sdState, 0, 3)],
    (unsigned long)(sdTotalB >> 20), (unsigned long)(sdFreeB() >> 20), TF(cameraReady), TF(recSupported), (unsigned long)framesDropped, (unsigned long)framesWritten, (unsigned long)motionEvents,
    up ? WiFi.RSSI() : 0, ip, ssid.c_str(), TF(apUp), apSsid, wm.c_str(), flashBrightness, (double)temperatureRead(), rr.c_str());
  sendJson(200, b);
}
static void hDiag() {
  String j = "{"; j += String("\"cpu\":") + ESP.getCpuFreqMHz() + ",\"heap\":" + ESP.getFreeHeap() + ",\"minHeap\":" + minFreeHeapSeen + ",\"psram\":" + ESP.getFreePsram() + ",\"minPsram\":" + heap_caps_get_minimum_free_size(MALLOC_CAP_SPIRAM);
  j += String(",\"temp\":") + String(temperatureRead(), 1) + ",\"sdms\":" + sdWriteMsAvg + ",\"sdmax\":" + sdWriteMsMax + ",\"sderr\":" + sdErrors + ",\"drop\":" + framesDropped + ",\"oversize\":" + oversizeDropped + ",\"camrec\":" + camRecoveries;
  j += String(",\"qdepth\":") + (recQ ? uxQueueMessagesWaiting(recQ) : 0) + ",\"sketch\":" + ESP.getSketchSize() + ",\"freeSketch\":" + ESP.getFreeSketchSpace() + ",\"fw\":\"" + FW_VERSION + "\"";
  j += ",\"rssi\":["; for (int i = 0; i < RSSI_RING; i++) { if (i) j += ","; j += rssiRing[(rssiHead + i) % RSSI_RING]; }
  j += "],\"resets\":\"" + jsonEsc(resetHistory().c_str()) + "\"}"; sendJson(200, j);
}

// ------------------------------------ files -----------------------------------
static void hDays() {
  String j = "{\"days\":["; auto d = sdDays(); bool first = true;
  for (int i = (int)d.size() - 1; i >= 0; i--) { if (!first) j += ","; first = false; j += "\"" + d[i] + "\""; }
  sendJson(200, j + "]}");
}
static void hList() {
  String day = server.arg("day"); if (!validDayName(day.c_str())) { sendErr(400, "day"); return; }
  std::vector<FEnt> fl; char dir[16]; snprintf(dir, sizeof dir, "/%s", day.c_str());
  if (!sdCardMounted || !sdList(dir, fl)) { sendErr(503, "busy"); return; }        // an error, never a fake empty list (v5 bug)
  String j; j.reserve(fl.size() * 44 + 40); j += "{\"day\":\"" + day + "\",\"files\":["; bool first = true;
  for (auto& f : fl) {
    if (f.dir) continue; size_t l = strlen(f.n); if (l < 5 || (strcasecmp(f.n + l - 4, ".avi") && strcasecmp(f.n + l - 4, ".jpg"))) continue;
    char p[64]; snprintf(p, sizeof p, "%s/%s", dir, f.n);
    if (!first) j += ","; first = false; j += String("{\"n\":\"") + jsonEsc(f.n) + "\",\"k\":" + (f.size / 1024) + ",\"o\":" + (isOpenPath(p) ? 1 : 0) + "}";
  }
  sendJson(200, j + "]}");
}
static void hStorage() {                                  // cached; the heavy folder scan runs in the maintenance task
  if (!storStatsMs || millis() - storStatsMs > 300000) storScanReq = true;
  sendJson(200, String("{\"totalMB\":") + (uint32_t)(sdTotalB >> 20) + ",\"usedMB\":" + (uint32_t)(sdUsedB >> 20) + ",\"freeMB\":" + (uint32_t)(sdFreeB() >> 20) +
           ",\"recMB\":" + (uint32_t)(storStats.rec >> 20) + ",\"motMB\":" + (uint32_t)(storStats.mot >> 20) + ",\"tlMB\":" + (uint32_t)(storStats.tl >> 20) +
           ",\"imgMB\":" + (uint32_t)(storStats.img >> 20) + ",\"files\":" + storStats.files + ",\"days\":" + storStats.days + "}");
}
static void hEvents() {
  String j = "{\"events\":["; for (int i = 0; i < eventCount; i++) {
    const EventRec& e = eventRing[(eventHead - 1 - i + EVENT_RING * 2) % EVENT_RING]; if (i) j += ",";
    j += String("{\"ts\":") + (long)e.ts + ",\"score\":" + e.score + ",\"pir\":" + (e.pir ? 1 : 0) + ",\"thumb\":\"" + jsonEsc(e.thumb) + "\",\"clip\":\"" + jsonEsc(e.clip) + "\"}";
  }
  sendJson(200, j + "]}");
}
static void hClipInfo() {
  String f = server.arg("file"); if (!validMediaPath(f.c_str())) { sendErr(400, "file"); return; }
  if (isOpenPath(f.c_str())) { sendJson(200, "{\"open\":true,\"indexed\":false}"); return; }
  AviInfo in; bool ok = false; if (sdLock(2000)) { File fh = SD_MMC.open(f.c_str(), FILE_READ); if (fh) { ok = aviParse(fh, in); fh.close(); } sdUnlock(); }
  if (!ok) { sendErr(404, "notavi"); return; }
  sendJson(200, String("{\"open\":false,\"indexed\":") + (in.indexed ? "true" : "false") + ",\"frames\":" + in.frames + ",\"fps\":" + String(in.fps, 2) + ",\"w\":" + in.w + ",\"h\":" + in.h + "}");
}
static void hDelete() {
  int count = 0; String mode = server.arg("mode");
  if (mode == "day" || mode == "all") {
    if (server.arg("confirm") != "DELETE") { sendErr(400, "confirm"); return; }
    for (auto& d : sdDays()) if (mode == "all" || d == server.arg("day")) count += deleteDay(d.c_str());
  } else {
    String list = server.arg("files"); int pos = 0;
    while (pos < (int)list.length()) {
      int e = list.indexOf('\n', pos); if (e < 0) e = list.length(); String p = list.substring(pos, e); p.trim(); pos = e + 1;
      if (!validMediaPath(p.c_str()) || isOpenPath(p.c_str())) continue;
      if (sdLock(2000)) { if (SD_MMC.remove(p.c_str())) count++; sdUnlock(); }
    }
  }
  storStatsMs = 0; sdInfoMs = 0; logmsg(LVL_INFO, "USER", "Deleted %d file(s)", count); sendJson(200, String("{\"ok\":true,\"deleted\":") + count + "}");
}
static void hRepair() {
  String f = server.arg("file"); if (!validMediaPath(f.c_str()) || strcasecmp(f.c_str() + f.length() - 4, ".avi") || isOpenPath(f.c_str())) { sendErr(400, "file"); return; }
  int n = -1; esp_task_wdt_reset(); if (sdLock(20000)) { n = aviRepair(f.c_str()); sdUnlock(); }
  logmsg(LVL_INFO, "SD", "Manual repair %s -> %d", f.c_str(), n); sendJson(n > 0 ? 200 : 500, String("{\"frames\":") + n + "}");
}
static void hCapture() {
  if (!capBuf) { sendErr(500, "nomem"); return; }
  size_t n = getSnapshot(capBuf, LATEST_BUF_SIZE); if (!n) { sendErr(503, "nocapture"); return; }
  server.sendHeader("Cache-Control", "no-store"); if (server.hasArg("dl")) server.sendHeader("Content-Disposition", "attachment; filename=\"snapshot.jpg\"");
  server.send_P(200, "image/jpeg", (const char*)capBuf, n);
}
static void hSnapshot() {
  if (!sdCardMounted || !capBuf) { sendErr(503, "nosd"); return; }
  size_t n = getSnapshot(capBuf, LATEST_BUF_SIZE); if (!n) { sendErr(503, "nocapture"); return; }
  char p[64]; bool ok = false;
  if (sdLock(2000)) { if (buildPath(p, sizeof p, "snap", "jpg", time(nullptr))) { File f = SD_MMC.open(p, FILE_WRITE); if (f) { ok = f.write(capBuf, n) == n; f.close(); } } sdUnlock(); }
  if (ok) { logmsg(LVL_INFO, "SNAP", "Saved %s", p); sendJson(200, String("{\"ok\":true,\"path\":\"") + p + "\"}"); } else sendErr(500, "write");
}

// ---------------------------------- controls ----------------------------------
static void hFlash() {
  int v = constrain(server.arg("val").toInt(), 0, FLASH_MAX_DUTY);
  if (v > 0 && flashBrightness == 0) manualFlashSince = millis(); if (v == 0) manualFlashSince = 0;
  flashBrightness = v; setFlashDuty(v); sendOk();
}
static void hSetTime() {
  long e = server.arg("epoch").toInt(); if (e < 1700000000L) { sendErr(400, "epoch"); return; }
  struct timeval tv = {(time_t)e, 0}; settimeofday(&tv, NULL); timeApprox = false; applyTimezone(); logmsg(LVL_INFO, "TIME", "Clock set from browser"); sendOk();
}
static void hReboot() { logmsg(LVL_WARN, "SYS", "Reboot requested from UI"); sendOk(); requestReboot(); }
static void hFactory() { if (server.arg("confirm") != "RESET") { sendErr(400, "confirm"); return; } sendOk(); delay(200); factoryReset(); }
static void hTgTest() {
  if (!capBuf) { sendErr(500, "nomem"); return; }
  size_t n = getSnapshot(capBuf, LATEST_BUF_SIZE); uint8_t* b = n ? (uint8_t*)heap_caps_malloc(n, MALLOC_CAP_SPIRAM) : nullptr;
  if (!b) { sendErr(503, "nocapture"); return; } memcpy(b, capBuf, n);
  Notify nf = {N_PHOTO, b, n, ""}; snprintf(nf.text, sizeof nf.text, "Test alert from %s", S_camname);
  if (xQueueSend(notifyQ, &nf, 0) != pdTRUE) { free(b); sendErr(503, "busy"); return; } sendOk();
}

// ---------------------------------- WiFi --------------------------------------
static void hWifiScan() {
  if (server.hasArg("start")) { sendJson(200, wifiScanStart() ? "{\"state\":\"running\"}" : "{\"state\":\"failed\"}"); return; }
  int n = WiFi.scanComplete();
  if (n == WIFI_SCAN_RUNNING) { sendJson(200, "{\"state\":\"running\"}"); return; }
  if (n < 0) { wifiScanHoldUntil = 0; sendJson(200, "{\"state\":\"failed\"}"); return; }
  String j = "{\"state\":\"done\",\"nets\":[";
  for (int i = 0; i < n; i++) { if (i) j += ","; j += String("{\"ssid\":\"") + jsonEsc(WiFi.SSID(i).c_str()) + "\",\"rssi\":" + WiFi.RSSI(i) + ",\"lock\":" + (WiFi.encryptionType(i) != WIFI_AUTH_OPEN ? "true" : "false") + "}"; }
  j += "],\"saved\":["; for (int i = 0; i < wnetCount; i++) { if (i) j += ","; j += String("\"") + jsonEsc(wnets[i].ssid) + "\""; }
  WiFi.scanDelete(); wifiScanHoldUntil = 0; sendJson(200, j + "]}");
}
static void hWifiConnect() {
  String s = server.arg("ssid"); if (!s.length() || s.length() > 32) { sendErr(400, "ssid"); return; }
  wifiAdd(s.c_str(), server.arg("pass").c_str()); wifiBeginTry(0); sendOk();
}
static void hWifiForget() { wifiForget(server.arg("ssid").c_str()); sendOk(); }

// ------------------------------------ logs -----------------------------------
static void hLogGet() {
  String j = "["; int start = logCount < LOG_RING ? 0 : logHead;
  for (int i = 0; i < logCount; i++) { if (i) j += ","; j += "\"" + jsonEsc(logRing[(start + i) % LOG_RING]) + "\""; }
  sendJson(200, j + "]");
}
static void hLogFile() {
  if (!sdCardMounted || !sdLock(3000)) { sendErr(503, "busy"); return; }
  File f = SD_MMC.open(LOG_FILE, FILE_READ); if (!f) { sdUnlock(); sendErr(404, "nolog"); return; }
  server.sendHeader("Content-Disposition", "attachment; filename=\"system.log\""); server.streamFile(f, "text/plain"); f.close(); sdUnlock();
}
static void hLogClear() {
  if (sdCardMounted && sdLock(2000)) { SD_MMC.remove(LOG_FILE); SD_MMC.remove(LOG_FILE_OLD); sdUnlock(); }
  if (xSemaphoreTake(logMx, pdMS_TO_TICKS(100)) == pdTRUE) { logHead = logCount = 0; xSemaphoreGive(logMx); }
  logmsg(LVL_INFO, "SYS", "Log cleared"); sendOk();
}

// ----------------------------------- OTA -------------------------------------
static bool otaAuthed = false;
static void otaUpload() {
  HTTPUpload& u = server.upload();
  if (u.status == UPLOAD_FILE_START) {
    otaAuthed = curRole() == ROLE_ADMIN && !pwMustChange && csrfOk(); if (!otaAuthed) return;
    otaBusy = true; recPaused = true; logmsg(LVL_WARN, "OTA", "Web update: %s", u.filename.c_str()); Update.begin(UPDATE_SIZE_UNKNOWN);
  } else if (u.status == UPLOAD_FILE_WRITE && otaAuthed) { if (Update.write(u.buf, u.currentSize) != u.currentSize) Update.printError(Serial);
  } else if (u.status == UPLOAD_FILE_END && otaAuthed) { if (!Update.end(true)) Update.printError(Serial);
  } else if (u.status == UPLOAD_FILE_ABORTED) { Update.abort(); otaBusy = false; recPaused = false; }
}
static void otaDone() {
  if (!otaAuthed) { sendErr(403, "auth"); return; }
  bool ok = !Update.hasError(); sendJson(ok ? 200 : 500, ok ? "{\"ok\":true}" : "{\"error\":\"update failed\"}");
  if (ok) requestReboot(); else { otaBusy = false; recPaused = false; }
  otaAuthed = false;
}

// ---------------------------------- routes ------------------------------------
static const char MANIFEST[] PROGMEM = "{\"name\":\"ESP32-CAM CCTV\",\"short_name\":\"CCTV\",\"start_url\":\"/\",\"display\":\"standalone\",\"background_color\":\"#0d1117\",\"theme_color\":\"#0d1117\",\"icons\":[{\"src\":\"/icon.svg\",\"sizes\":\"any\",\"type\":\"image/svg+xml\"}]}";
static const char ICON_SVG[] PROGMEM = "<svg xmlns='http://www.w3.org/2000/svg' viewBox='0 0 64 64'><rect width='64' height='64' rx='14' fill='#0d1117'/><circle cx='32' cy='32' r='14' fill='none' stroke='#f2a93b' stroke-width='5'/><circle cx='32' cy='32' r='5' fill='#f2a93b'/></svg>";

void registerRoutes() {
  capBuf = (uint8_t*)heap_caps_malloc(LATEST_BUF_SIZE, MALLOC_CAP_SPIRAM);
  server.collectHeaders(HDRS, 2);
  server.on("/", HTTP_GET, []() { server.sendHeader("Content-Encoding", "gzip"); server.sendHeader("Cache-Control", "no-cache"); server.send_P(200, "text/html", (const char*)WEB_UI_GZ, WEB_UI_GZ_LEN); });
  server.on("/manifest.json", HTTP_GET, []() { server.send_P(200, "application/manifest+json", MANIFEST); });
  server.on("/icon.svg", HTTP_GET, []() { server.send_P(200, "image/svg+xml", ICON_SVG); });
  server.on("/api/session", HTTP_GET, hSession);
  server.on("/api/login", HTTP_POST, hLogin);
  server.on("/api/logout", HTTP_POST, hLogout);
  server.on("/api/account", HTTP_POST, []() { if (!guard(ROLE_ADMIN, true, true)) return; hAccount(); });

  GETR("/api/config", ROLE_VIEWER, hConfigGet);   POSTR("/api/config", ROLE_ADMIN, hConfigPost);   POSTR("/api/preset", ROLE_ADMIN, hPreset);
  GETR("/api/backup", ROLE_ADMIN, hBackup);
  GETR("/api/status", ROLE_VIEWER, hStatus);      GETR("/api/diag", ROLE_ADMIN, hDiag);
  GETR("/api/days", ROLE_VIEWER, hDays);          GETR("/api/list", ROLE_VIEWER, hList);           GETR("/api/storage", ROLE_VIEWER, hStorage);
  GETR("/api/events", ROLE_VIEWER, hEvents);      GETR("/api/clipinfo", ROLE_VIEWER, hClipInfo);
  POSTR("/api/delete", ROLE_ADMIN, hDelete);      POSTR("/api/repair", ROLE_ADMIN, hRepair);
  GETR("/capture", ROLE_VIEWER, hCapture);        POSTR("/api/snapshot", ROLE_ADMIN, hSnapshot);
  POSTR("/api/flash", ROLE_ADMIN, hFlash);        POSTR("/api/settime", ROLE_ADMIN, hSetTime);
  POSTR("/api/reboot", ROLE_ADMIN, hReboot);      POSTR("/api/factory", ROLE_ADMIN, hFactory);     POSTR("/api/tgtest", ROLE_ADMIN, hTgTest);
  GETR("/api/wifi/scan", ROLE_ADMIN, hWifiScan);  POSTR("/api/wifi/connect", ROLE_ADMIN, hWifiConnect); POSTR("/api/wifi/forget", ROLE_ADMIN, hWifiForget);
  GETR("/api/log", ROLE_ADMIN, hLogGet);          GETR("/api/logfile", ROLE_ADMIN, hLogFile);      POSTR("/api/logclear", ROLE_ADMIN, hLogClear);
  server.on("/api/ota", HTTP_POST, otaDone, otaUpload);
  server.onNotFound([]() {
    String h = server.hostHeader();
    if (apUp && !h.startsWith("192.168.4.1") && !h.endsWith(".local")) { server.sendHeader("Location", "http://192.168.4.1/"); server.send(302, "text/plain", ""); return; }   // captive portal
    sendErr(404, "notfound");
  });
  server.begin();
}
